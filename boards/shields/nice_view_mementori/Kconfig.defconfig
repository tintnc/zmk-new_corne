## boards/shields/nice_view_mementori/Kconfig.defconfig
```kconfig
if SHIELD_NICE_VIEW_MEMENTORI

config ZMK_DISPLAY
    default y

config LS0XX_VCOM_THREAD_PRIO
    default 11

config LV_Z_VDB_SIZE
    default 100

config LV_DPI_DEF
    default 161

config LV_Z_BITS_PER_PIXEL
    default 1

choice LV_COLOR_DEPTH
    default LV_COLOR_DEPTH_1
endchoice

choice ZMK_DISPLAY_WORK_QUEUE
    default ZMK_DISPLAY_WORK_QUEUE_DEDICATED
endchoice

choice ZMK_DISPLAY_STATUS_SCREEN
    default ZMK_DISPLAY_STATUS_SCREEN_CUSTOM
endchoice

# Custom coordinate configurations compatible with standard nice!view widgets
config NICE_VIEW_MEMENTORI_CUSTOM_X
    int "Mementori X offset"
    default 0

config NICE_VIEW_MEMENTORI_CUSTOM_Y
    int "Mementori Y offset"
    default 0

endif
```

## boards/shields/nice_view_mementori/Kconfig.shield
```kconfig
config SHIELD_NICE_VIEW_MEMENTORI
    def_bool $(shields_list_contains,nice_view_mementori)
    select LV_USE_CANVAS
    select LV_USE_IMG
    select LV_USE_LABEL
    select LV_FONT_MONTSERRAT_16
```
